## Kconfig
```kconfig
# SPDX-License-Identifier: GPL-2.0
#
# For a description of the syntax of this configuration file,
# see Documentation/kbuild/kconfig-language.txt.
#
mainmenu "Linux/$ARCH $KERNELVERSION Kernel Configuration"

config SRCARCH
	string
	option env="SRCARCH"

#ifdef CONFIG_OPLUS_SYSTEM_KERNEL
config OPLUS_SYSTEM_KERNEL_QCOM
	bool "config oplus system feature "
	default y
	help
		define this config to Distinguish between qcom and mtk platform

config OPLUS_FEATURE_PANIC_FLUSH
	bool "fsync optimization "
	default y
	help
		define this config to fsync optimization
config OPLUS_SYSTEM_KERNEL_MTK
	bool "config oplus system feature "
	default n
	help
		define this config to Distinguish between qcom and mtk platform
#endif /*CONFIG_OPLUS_SYSTEM_KERNEL*/

source "arch/$SRCARCH/Kconfig"
```

## drivers/input/touchscreen/oppo_touchscreen/Novatek/Kconfig
```kconfig
source "drivers/input/touchscreen/oppo_touchscreen/Novatek/NT36525B_noflash/Kconfig"
source "drivers/input/touchscreen/oppo_touchscreen/Novatek/NT36672A_noflash/Kconfig"
```

## drivers/input/touchscreen/oppo_touchscreen/Novatek/NT36672A_noflash/Kconfig
```kconfig
config TOUCHPANEL_NOVA_NT36672A_NOFLASH
#	default y
	bool "TP nova nt36672A IC enable or not for OPPO"
	---help---
	say Y to enable driver for Touchpanel useing nova nt36672
```

## drivers/power/Kconfig
```kconfig
#ifdef OPLUS_FEATURE_CHG_BASIC
config OPLUS_SM6125R_CHARGER
	tristate "CONFIG_OPLUS_SM6125R_CHARGER driver"
	help
	  Enables support for the oplus charging framework
config OPLUS_SM6125_CHARGER
	tristate "CONFIG_OPLUS_SM6125_CHARGER driver"
	help
	  Enables support for the oplus charging framework

config OPLUS_SHORT_C_BATT_CHECK
	bool "OPLUS batt short "
	help
	  Say Y here to declare OPLUS batt short

config OPLUS_RTC_DET_SUPPORT
	tristate "OPLUS RTC DET SUPPORT"
	default n
	help
	  Say Y to include support

config OPLUS_CHECK_CHARGERID_VOLT
	tristate "OPLUS CHECK CHARGERID VOLT"
	default n
	help
	  Say Y to include support

config OPLUS_SHIP_MODE_SUPPORT
	tristate "OPLUS_SHIP_MODE_SUPPORT"
	default n
	help
	  Say Y to include support

config OPLUS_CALL_MODE_SUPPORT
	tristate "OPLUS_CALL_MODE_SUPPORT"
	default n
	help
	  Say Y to include support

config OPLUS_SHORT_IC_CHECK
	bool "OPLUS short ic"
	help
	  Say Y here to declare OPLUS batt short

config OPLUS_SHORT_HW_CHECK
	bool "OPLUS batt HW SHORT "
	help
	  Say Y here to declare charging system is on MTK

config OPLUS_CHIP_SOC_NODE
	bool "OPLUS chip soc node"
	help
	  Say Y to include support

config OPLUS_SMART_CHARGER_SUPPORT
	bool "OPLUS smart charge support"
	help
	  Say Y to include support

source "drivers/power/oplus/Kconfig"
#endif

source "drivers/power/avs/Kconfig"
source "drivers/power/reset/Kconfig"
source "drivers/power/supply/Kconfig"
```

## drivers/soc/oplus/Kconfig
```kconfig
#ifdef OPLUS_FEATURE_TP_BASIC
config OPPO_COMMON_SOFT
  bool "config oppo common software"
  select OPPO_ARCH_FILE
  help
        define this config to get project verion from sharemem.
        Maybe this value is from CDT or dynamic identify by hardware
        id.

config OPPO_DEVICE_IFNO
  bool "config oppo devinfo"
  select OPPO_ARCH_FILE
  help
        define this config to compile devinfo.c for device register

source "drivers/soc/oplus/device_info/Kconfig"
#endif /* OPLUS_FEATURE_TP_BASIC */

#ifdef OPLUS_FEATURE_LOWMEM_DBG
source "drivers/soc/oplus/lowmem_dbg/Kconfig"
##endif /* OPLUS_FEATURE_LOWMEM_DBG */

#ifdef OPLUS_FEATURE_MEMLEAK_DETECT
source "drivers/soc/oplus/oppo_svelte/Kconfig"
#endif /* OPLUS_FEATURE_MEMLEAK_DETECT */

#ifdef OPLUS_FEATURE_THERMAL_HORAE
source "drivers/soc/oplus/thermal/Kconfig"
#endif /* OPLUS_FEATURE_THERMAL_HORAE */

#ifdef OPLUS_FEATURE_POWERINFO_STANDBY
source "drivers/soc/oplus/owakelock/Kconfig"
#endif /* OPLUS_FEATURE_POWERINFO_STANDBY */
```
